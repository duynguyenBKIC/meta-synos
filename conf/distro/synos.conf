## conf/distro/synos.conf
```bitbake
# Distribution Metadata
DISTRO = "synos"
DISTRO_NAME = "SynOS (Custom Yocto OS)"
DISTRO_VERSION = "1.0.0"
DISTRO_CODENAME = "synos"
MAINTAINER = "SynOS Developers"

# Target and SDK Naming Configuration
# These replace the default "poky" vendor strings in toolchain names
TARGET_VENDOR = "-synos"
SDK_VENDOR = "-synossdk"
SDK_VERSION = "${DISTRO_VERSION}"

# Core Toolchain Settings
# Defines the C library (glibc is standard, musl is a lightweight alternative)
TCLIBC = "glibc"

# Packaging Strategy
# Choices: package_ipk (fast/light), package_rpm (standard), package_deb
PACKAGE_CLASSES ?= "package_ipk"

# Base Distribution Features
# We define essential Linux features since we aren't inheriting Poky's defaults
DISTRO_FEATURES_DEFAULT = "acl argp ext2 ipv4 ipv6 largefile xattr nls usrmerge"
DISTRO_FEATURES = "${DISTRO_FEATURES_DEFAULT} opengl wayland pam x11"

# Systemd Configuration
# Effectively replaces SysVinit with Systemd as the primary init manager
DISTRO_FEATURES:append = " systemd"
VIRTUAL-RUNTIME_init_manager = "systemd"
DISTRO_FEATURES_BACKFILL_CONSIDERED += "sysvinit"
VIRTUAL-RUNTIME_initscripts = "systemd-compat-units"

# SDK Path Configuration
# Defines where the generated SDK will be installed by default
SDK_NAME = "${DISTRO}-${TCLIBC}-${SDKMACHINE}-${IMAGE_BASENAME}-${TUNE_PKGARCH}-${MACHINE}"
SDKPATHINSTALL = "/opt/${DISTRO}/${SDK_VERSION}"

# Accept the proprietary license for Raspberry Pi Wi-Fi/Bluetooth firmware
LICENSE_FLAGS_ACCEPTED += "synaptics-killswitch"

# Performance & Speed Optimizations
# Use Shared State Hash Server for faster incremental builds
BB_SIGNATURE_HANDLER ?= "OEEquivHash"
BB_HASHSERVE ??= "auto"

# Security and Footprint Improvements
# Disables static library generation to reduce image size
require conf/distro/include/no-static-libs.inc
# Includes common security compiler flags
require conf/distro/include/security_flags.inc
```

## conf/layer.conf
```bitbake
# We have a conf and classes directory, add to BBPATH
BBPATH .= ":${LAYERDIR}"

# We have recipes-* directories, add to BBFILES
BBFILES += "${LAYERDIR}/recipes-*/*/*.bb \
            ${LAYERDIR}/recipes-*/*/*.bbappend"

BBFILE_COLLECTIONS += "meta-synos"
BBFILE_PATTERN_meta-synos = "^${LAYERDIR}/"
BBFILE_PRIORITY_meta-synos = "6"

LAYERDEPENDS_meta-synos = "core"
LAYERSERIES_COMPAT_meta-synos = "kirkstone nanbield scarthgap"
```
